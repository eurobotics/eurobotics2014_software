/*  
 *  Copyright Robotics Association of Coslada, Eurobotics Engineering (2011)
 * 
 *  This program is free software; you can redistribute it and/or modify
 *  it under the terms of the GNU General Public License as published by
 *  the Free Software Foundation; either version 2 of the License, or
 *  (at your option) any later version.
 *
 *  This program is distributed in the hope that it will be useful,
 *  but WITHOUT ANY WARRANTY; without even the implied warranty of
 *  MERCHANTABILITY or FITNESS FOR A PARTICULAR PURPOSE.  See the
 *  GNU General Public License for more details.
 *
 *  You should have received a copy of the GNU General Public License
 *  along with this program; if not, write to the Free Software
 *  Foundation, Inc., 59 Temple Place, Suite 330, Boston, MA  02111-1307  USA
 *
 *  Revision : $Id$
 *
 *  Javier Baliсas Santos <javier@arc-robots.org>
 */

#include <stdio.h>
#include <stdint.h>

#include <aversive.h>
#include <aversive/pgmspace.h>
#include <aversive/wait.h>
#include <aversive/error.h>

#include <uart.h>
#include <i2c.h>
#include <parse.h>
#include <rdline.h>
#include <pwm_mc.h>
#include <encoders_dspic.h>
#include <timer.h>
#include <scheduler.h>
#include <pid.h>
#include <clock_time.h>
#include <quadramp.h>
#include <control_system_manager.h>
#include <blocking_detection_manager.h>

#include "main.h"
#include "beacon.h"
#include "beacon_calib.h"

/* debug macros */
#define BEACON_DEBUG(args...) DEBUG(E_USER_BEACON, args)
#define BEACON_NOTICE(args...) NOTICE(E_USER_BEACON, args)
#define BEACON_ERROR(args...) ERROR(E_USER_BEACON, args)

/* 180 deg. sensor adjusts - Opponent detection:
	Angle: at 10 cm of a vertical white paper, external ring (low point tangent) at 102 mm high.
	Power: with the angle adjusted, no detection at 39 cm with a vertical white paper.
*/

/* 0 deg. Sensor adjusts -  Second robot detection:
	Angle: at 10 cm of a vertical white paper, external ring (low point tangent) at 95.5 mm high.
	Power: with the angle adjusted, no detection at 20 cm with a vertical white paper.

	NOTE: beacon needs to add a black tape of 1cm at the top of beacon in order to the second
			robot's beacon don't be detected by 180deg sensor (opponents measurements).
*/


/* SENSOR 180 ***************************************************************************/

/* size measure params */
#define S180_MEASURE_MAX	4040
#define S180_MEASURE_MIN 	744

/* get distance params */
#define S180_X_EVAL_DELTA	8
#define S180_X_EVAL_MIN		744
#define S180_ARRAY_SIZE		413


uint8_t measure2distance_sensor_180 [] = {
30	,
30	,
30	,
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79	,
79 };

/* SENSOR 0 ***************************************************************************/

/* size measure params */
#define S0_MEASURE_MAX	4500
#define S0_MEASURE_MIN 	1236 //820

/* get distance params */
#define S0_X_EVAL_DELTA		8
#define S0_X_EVAL_MIN		820
#define S0_ARRAY_SIZE		461

uint16_t measure2distance_sensor_0 [] = {
30	,
30	,
30	,
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226	,
227 };

/* get distance (cm) from relative size */
uint16_t get_dist_array(uint8_t sensor, int32_t size, int32_t period)
{
	uint32_t measure;
	uint16_t index;

	/* calculate measure */
	measure = (uint32_t)((size*100000)/period);

	if(sensor == IR_SENSOR_180_DEG) 
	{
		/* saturate to working range */
		if(measure > S180_MEASURE_MAX)
			measure = S180_MEASURE_MAX;
		if(measure < S180_MEASURE_MIN)
			measure = S180_MEASURE_MIN;
	
		/* calculate array index */
		index = (S180_ARRAY_SIZE-1) - ((measure-S180_X_EVAL_MIN)/S180_X_EVAL_DELTA);	
	
		//BEACON_DEBUG("measure = %.4ld / index = %.3d / dist = %.3d cm",
		//		       measure, index, measure2distance_sensor_180[index]);
	
		/* return distance from array in mm */
		return (measure2distance_sensor_180[index]*10);
	}
	else 
	{
		/* HACK: because sensor intesity power was changed before calibration */
		//measure += 1008;

		/* saturate to working range */
		if(measure > S0_MEASURE_MAX)
			measure = S0_MEASURE_MAX;
		if(measure < S0_MEASURE_MIN) {
			measure = S0_MEASURE_MIN;
			return DIST_ERROR;			/* HACK for not detect s180 beacon, very specific case */
		}
	
		/* calculate array index */
		index = (S0_ARRAY_SIZE-1) - ((measure-S0_X_EVAL_MIN)/S0_X_EVAL_DELTA);	
	
		//BEACON_DEBUG("measure = %.4ld / index = %.3d / dist = %.3d cm",
		//		       measure, index, measure2distance_sensor_0[index]);
	
		/* return distance from array in mm */
		return (measure2distance_sensor_0[index]*10);
	}

}
